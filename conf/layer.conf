## conf/layer.conf
```bitbake
#
# Copyright (C) 2016 Wind River Systems, Inc.
#

# We have a conf and classes directory, add to BBPATH
BBPATH =. "${LAYERDIR}:"

# We have a packages directory, add to BBFILES
BBFILES += "${LAYERDIR}/recipes-*/*/*.bb \
	${LAYERDIR}/recipes-*/*/*.bbappend"

BBFILE_COLLECTIONS += "meta-dpdk"
BBFILE_PATTERN_meta-dpdk = "^${LAYERDIR}/"
BBFILE_PRIORITY_meta-dpdk = "6"

# This should only be incremented on significant changes that will
# cause compatibility issues with other layers
LAYERVERSION_meta-dpdk = "1"
```
